[part 1 of 2: package /ComponentType]
AUTOSAR XML (schema 3.0.1)
standard types defined: Boolean, UInt8
package /ComponentType
  service component type NvM: category=ServiceComponent  # Software Component description for NvM generated from Ecuc Package: VMCU
    286 x provide port:
      PS_ConfigBlock: provided-interface=NvM_AC3_SRBS_Srv  # PPort_ConfigBlock : NvM_AC3_SRBS_Srv | P-Port Prototype of NvM_AC3_SRBS_Srv for NVRAM Block ConfigBlock
      PS_VS_nv_KFactor: provided-interface=NvM_AC3_SRBS_Srv_Defs  # PPort_VS_nv_KFactor : NvM_AC3_SRBS_Srv_Defs | P-Port Prototype of NvM_AC3_SRBS_Srv_Defs for NVRAM Block VS_nv_KFactor
      PS_ExtraLights_BlackOutMgr_ElcBlackOutManager_States: provided-interface=NvM_AC3_SRBS_Srv_Defs  # PPort_ExtraLights_BlackOutMgr_ElcBlackOutManager_States : NvM_AC3_SRBS_Srv_Defs | P-Port Prototype of NvM_AC3_SRBS_Srv_Defs for NVRAM Block ExtraLights_BlackOutMgr_ElcBlackOutManager_States
      PS_MaxLightCircuit_maxLightIntensityLevel: provided-interface=NvM_AC3_SRBS_Srv_Defs  # PPort_MaxLightCircuit_maxLightIntensityLevel : NvM_AC3_SRBS_Srv_Defs | P-Port Prototype of NvM_AC3_SRBS_Srv_Defs for NVRAM Block MaxLightCircuit_maxLightIntensityLevel
      PS_NightLightCircuit_nightLightIntensityLevel: provided-interface=NvM_AC3_SRBS_Srv_Defs  # PPort_NightLightCircuit_nightLightIntensityLevel : NvM_AC3_SRBS_Srv_Defs | P-Port Prototype of NvM_AC3_SRBS_Srv_Defs for NVRAM Block NightLightCircuit_nightLightIntensityLevel
      PS_RequestManager_IL3_ActiveMode: provided-interface=NvM_AC3_SRBS_Srv_Defs  # PPort_RequestManager_IL3_ActiveMode : NvM_AC3_SRBS_Srv_Defs | P-Port Prototype of NvM_AC3_SRBS_Srv_Defs for NVRAM Block RequestManager_IL3_ActiveMode
      PS_RestingLightCircuit_restingLightIntensityLevel: provided-interface=NvM_AC3_SRBS_Srv_Defs  # PPort_RestingLightCircuit_restingLightIntensityLevel : NvM_AC3_SRBS_Srv_Defs | P-Port Prototype of NvM_AC3_SRBS_Srv_Defs for NVRAM Block RestingLightCircuit_restingLightIntensityLevel
      PS_EL2_BlackOutMgr_EL2_BlackOutMgrState: provided-interface=NvM_AC3_SRBS_Srv_Defs  # PPort_EL2_BlackOutMgr_EL2_BlackOutMgrState : NvM_AC3_SRBS_Srv_Defs | P-Port Prototype of NvM_AC3_SRBS_Srv_Defs for NVRAM Block EL2_BlackOutMgr_EL2_BlackOutMgrState
      PS_EX_HMI_ELH_Storage: provided-interface=NvM_AC3_SRBS_Srv_Defs  # PPort_EX_HMI_ELH_Storage : NvM_AC3_SRBS_Srv_Defs | P-Port Prototype of NvM_AC3_SRBS_Srv_Defs for NVRAM Block EX_HMI_ELH_Storage
      PS_Rte_NvmBlock_BatteryLog_BCLBatteryTimeSOCHisto_log: provided-interface=NvM_AC3_SRBS_Srv_Defs  # PPort_Rte_NvmBlock_BatteryLog_BCLBatteryTimeSOCHisto_log : NvM_AC3_SRBS_Srv_Defs | P-Port Prototype of NvM_AC3_SRBS_Srv_Defs for NVRAM Block Rte_NvmBlock_BatteryLog_BCLBatteryTimeSOCHisto_log
      PS_Rte_NvmBlock_IARL_IarEngineTimeHistogramPeriods: provided-interface=NvM_AC3_SRBS_Srv_Defs  # PPort_Rte_NvmBlock_IARL_IarEngineTimeHistogramPeriods : NvM_AC3_SRBS_Srv_Defs | P-Port Prototype of NvM_AC3_SRBS_Srv_Defs for NVRAM Block Rte_NvmBlock_IARL_IarEngineTimeHistogramPeriods
      PS_Rte_NvmBlock_VSGL_TLVehicleStartConditionCounterStartingGearHisto_log: provided-interface=NvM_AC3_SRBS_Srv_Defs  # PPort_Rte_NvmBlock_VSGL_TLVehicleStartConditionCounterStartingGearHisto_log : NvM_AC3_SRBS_Srv_Defs | P-Port Prototype of NvM_AC3_SRBS_Srv_Defs for NVRAM Block Rte_NvmBlock_VSGL_TLVehicleStartConditionCounterStartingGearHisto_log
      PS_NV_AccDistPrimNVM: provided-interface=NvM_AC3_SRBS_Srv_Defs  # PPort_NV_AccDistPrimNVM : NvM_AC3_SRBS_Srv_Defs | P-Port Prototype of NvM_AC3_SRBS_Srv_Defs for NVRAM Block NV_AccDistPrimNVM
      PS_NV_AccDistSecndNVM: provided-interface=NvM_AC3_SRBS_Srv_Defs  # PPort_NV_AccDistSecndNVM : NvM_AC3_SRBS_Srv_Defs | P-Port Prototype of NvM_AC3_SRBS_Srv_Defs for NVRAM Block NV_AccDistSecndNVM
      PS_NV_TripDist1NVM: provided-interface=NvM_AC3_SRBS_Srv_Defs  # PPort_NV_TripDist1NVM : NvM_AC3_SRBS_Srv_Defs | P-Port Prototype of NvM_AC3_SRBS_Srv_Defs for NVRAM Block NV_TripDist1NVM
      PS_NV_TripDist2NVM: provided-interface=NvM_AC3_SRBS_Srv_Defs  # PPort_NV_TripDist2NVM : NvM_AC3_SRBS_Srv_Defs | P-Port Prototype of NvM_AC3_SRBS_Srv_Defs for NVRAM Block NV_TripDist2NVM
      PS_NV_DiagmaxResDataNVM: provided-interface=NvM_AC3_SRBS_Srv  # PPort_NV_DiagmaxResDataNVM : NvM_AC3_SRBS_Srv | P-Port Prototype of NvM_AC3_SRBS_Srv for NVRAM Block NV_DiagmaxResDataNVM
      PS_Rte_NvmBlock_WWHMI_RainSensorStatus: provided-interface=NvM_AC3_SRBS_Srv_Defs  # PPort_Rte_NvmBlock_WWHMI_RainSensorStatus : NvM_AC3_SRBS_Srv_Defs | P-Port Prototype of NvM_AC3_SRBS_Srv_Defs for NVRAM Block Rte_NvmBlock_WWHMI_RainSensorStatus
      PS_Rte_NvmBlock_CCM_DriverSettingsStored: provided-interface=NvM_AC3_SRBS_Srv_Defs  # PPort_Rte_NvmBlock_CCM_DriverSettingsStored : NvM_AC3_SRBS_Srv_Defs | P-Port Prototype of NvM_AC3_SRBS_Srv_Defs for NVRAM Block Rte_NvmBlock_CCM_DriverSettingsStored
      PS_Rte_NvmBlock_RSL_TRSLTargetSpeed: provided-interface=NvM_AC3_SRBS_Srv_Defs  # PPort_Rte_NvmBlock_RSL_TRSLTargetSpeed : NvM_AC3_SRBS_Srv_Defs | P-Port Prototype of NvM_AC3_SRBS_Srv_Defs for NVRAM Block Rte_NvmBlock_RSL_TRSLTargetSpeed
      PS_Rte_NvmBlock_KeyAuthentication_KeyAuthenticationContactToImmo: provided-interface=NvM_AC3_SRBS_Srv_Defs  # PPort_Rte_NvmBlock_KeyAuthentication_KeyAuthenticationContactToImmo : NvM_AC3_SRBS_Srv_Defs | P-Port Prototype of NvM_AC3_SRBS_Srv_Defs for NVRAM Block Rte_NvmBlock_KeyAuthentication_KeyAuthenticationContactToImmo
      PS_Rte_NvmBlock_ADCL_PM_AirDryerCartridgeLogging: provided-interface=NvM_AC3_SRBS_Srv_Defs  # PPort_Rte_NvmBlock_ADCL_PM_AirDryerCartridgeLogging : NvM_AC3_SRBS_Srv_Defs | P-Port Prototype of NvM_AC3_SRBS_Srv_Defs for NVRAM Block Rte_NvmBlock_ADCL_PM_AirDryerCartridgeLogging
      PS_Rte_NvmBlock_ADC_PM_AirDryerCartridgeMonitor: provided-interface=NvM_AC3_SRBS_Srv_Defs  # PPort_Rte_NvmBlock_ADC_PM_AirDryerCartridgeMonitor : NvM_AC3_SRBS_Srv_Defs | P-Port Prototype of NvM_AC3_SRBS_Srv_Defs for NVRAM Block Rte_NvmBlock_ADC_PM_AirDryerCartridgeMonitor
      PS_Rte_NvmBlock_AirFilter_PM_StandardMonitor: provided-interface=NvM_AC3_SRBS_Srv_Defs  # PPort_Rte_NvmBlock_AirFilter_PM_StandardMonitor : NvM_AC3_SRBS_Srv_Defs | P-Port Prototype of NvM_AC3_SRBS_Srv_Defs for NVRAM Block Rte_NvmBlock_AirFilter_PM_StandardMonitor
      PS_Rte_NvmBlock_AlternatorBrush_PM_StandardMonitor: provided-interface=NvM_AC3_SRBS_Srv_Defs  # PPort_Rte_NvmBlock_AlternatorBrush_PM_StandardMonitor : NvM_AC3_SRBS_Srv_Defs | P-Port Prototype of NvM_AC3_SRBS_Srv_Defs for NVRAM Block Rte_NvmBlock_AlternatorBrush_PM_StandardMonitor
      PS_Rte_NvmBlock_AxleOil_PM_StandardMonitor: provided-interface=NvM_AC3_SRBS_Srv_Defs  # PPort_Rte_NvmBlock_AxleOil_PM_StandardMonitor : NvM_AC3_SRBS_Srv_Defs | P-Port Prototype of NvM_AC3_SRBS_Srv_Defs for NVRAM Block Rte_NvmBlock_AxleOil_PM_StandardMonitor
      PS_Rte_NvmBlock_BSOH_PM_BatterySOHMonitor: provided-interface=NvM_AC3_SRBS_Srv_Defs  # PPort_Rte_NvmBlock_BSOH_PM_BatterySOHMonitor : NvM_AC3_SRBS_Srv_Defs | P-Port Prototype of NvM_AC3_SRBS_Srv_Defs for NVRAM Block Rte_NvmBlock_BSOH_PM_BatterySOHMonitor
      PS_Rte_NvmBlock_BrakePads_PM_StandardMonitor: provided-interface=NvM_AC3_SRBS_Srv_Defs  # PPort_Rte_NvmBlock_BrakePads_PM_StandardMonitor : NvM_AC3_SRBS_Srv_Defs | P-Port Prototype of NvM_AC3_SRBS_Srv_Defs for NVRAM Block Rte_NvmBlock_BrakePads_PM_StandardMonitor
      PS_Rte_NvmBlock_ChassisLubrification_PM_StandardMonitor: provided-interface=NvM_AC3_SRBS_Srv_Defs  # PPort_Rte_NvmBlock_ChassisLubrification_PM_StandardMonitor : NvM_AC3_SRBS_Srv_Defs | P-Port Prototype of NvM_AC3_SRBS_Srv_Defs for NVRAM Block Rte_NvmBlock_ChassisLubrification_PM_StandardMonitor
      PS_Rte_NvmBlock_Clutch_PM_StandardMonitor: provided-interface=NvM_AC3_SRBS_Srv_Defs  # PPort_Rte_NvmBlock_Clutch_PM_StandardMonitor : NvM_AC3_SRBS_Srv_Defs | P-Port Prototype of NvM_AC3_SRBS_Srv_Defs for NVRAM Block Rte_NvmBlock_Clutch_PM_StandardMonitor
      PS_Rte_NvmBlock_CoolantConditionerChange_PM_StandardMonitor: provided-interface=NvM_AC3_SRBS_Srv_Defs  # PPort_Rte_NvmBlock_CoolantConditionerChange_PM_StandardMonitor : NvM_AC3_SRBS_Srv_Defs | P-Port Prototype of NvM_AC3_SRBS_Srv_Defs for NVRAM Block Rte_NvmBlock_CoolantConditionerChange_PM_StandardMonitor
      PS_Rte_NvmBlock_Coolant_PM_StandardMonitor: provided-interface=NvM_AC3_SRBS_Srv_Defs  # PPort_Rte_NvmBlock_Coolant_PM_StandardMonitor : NvM_AC3_SRBS_Srv_Defs | P-Port Prototype of NvM_AC3_SRBS_Srv_Defs for NVRAM Block Rte_NvmBlock_Coolant_PM_StandardMonitor
      PS_Rte_NvmBlock_Customer{1..4}_PM_StandardMonitor: provided-interface=NvM_AC3_SRBS_Srv_Defs  # PPort_Rte_NvmBlock_Customer{1..4}_PM_StandardMonitor : NvM_AC3_SRBS_Srv_Defs | P-Port Prototype of NvM_AC3_SRBS_Srv_Defs for NVRAM Block Rte_NvmBlock_Customer{1..4}_PM_StandardMonitor
      PS_Rte_NvmBlock_DPFAshCleaning_PM_StandardMonitor: provided-interface=NvM_AC3_SRBS_Srv_Defs  # PPort_Rte_NvmBlock_DPFAshCleaning_PM_StandardMonitor : NvM_AC3_SRBS_Srv_Defs | P-Port Prototype of NvM_AC3_SRBS_Srv_Defs for NVRAM Block Rte_NvmBlock_DPFAshCleaning_PM_StandardMonitor
      PS_Rte_NvmBlock_DPFElectrodeCleaning_PM_StandardMonitor: provided-interface=NvM_AC3_SRBS_Srv_Defs  # PPort_Rte_NvmBlock_DPFElectrodeCleaning_PM_StandardMonitor : NvM_AC3_SRBS_Srv_Defs | P-Port Prototype of NvM_AC3_SRBS_Srv_Defs for NVRAM Block Rte_NvmBlock_DPFElectrodeCleaning_PM_StandardMonitor
      PS_Rte_NvmBlock_DPFFuelNozzleCleaning_PM_StandardMonitor: provided-interface=NvM_AC3_SRBS_Srv_Defs  # PPort_Rte_NvmBlock_DPFFuelNozzleCleaning_PM_StandardMonitor : NvM_AC3_SRBS_Srv_Defs | P-Port Prototype of NvM_AC3_SRBS_Srv_Defs for NVRAM Block Rte_NvmBlock_DPFFuelNozzleCleaning_PM_StandardMonitor
      PS_Rte_NvmBlock_EmissionTurboInjectionService_PM_StandardMonitor: provided-interface=NvM_AC3_SRBS_Srv_Defs  # PPort_Rte_NvmBlock_EmissionTurboInjectionService_PM_StandardMonitor : NvM_AC3_SRBS_Srv_Defs | P-Port Prototype of NvM_AC3_SRBS_Srv_Defs for NVRAM Block Rte_NvmBlock_EmissionTurboInjectionService_PM_StandardMonitor
      PS_Rte_NvmBlock_EngineBelt_PM_StandardMonitor: provided-interface=NvM_AC3_SRBS_Srv_Defs  # PPort_Rte_NvmBlock_EngineBelt_PM_StandardMonitor : NvM_AC3_SRBS_Srv_Defs | P-Port Prototype of NvM_AC3_SRBS_Srv_Defs for NVRAM Block Rte_NvmBlock_EngineBelt_PM_StandardMonitor
      PS_Rte_NvmBlock_FanClutchChange_PM_StandardMonitor: provided-interface=NvM_AC3_SRBS_Srv_Defs  # PPort_Rte_NvmBlock_FanClutchChange_PM_StandardMonitor : NvM_AC3_SRBS_Srv_Defs | P-Port Prototype of NvM_AC3_SRBS_Srv_Defs for NVRAM Block Rte_NvmBlock_FanClutchChange_PM_StandardMonitor
      PS_Rte_NvmBlock_FuelFilterChange_PM_StandardMonitor: provided-interface=NvM_AC3_SRBS_Srv_Defs  # PPort_Rte_NvmBlock_FuelFilterChange_PM_StandardMonitor : NvM_AC3_SRBS_Srv_Defs | P-Port Prototype of NvM_AC3_SRBS_Srv_Defs for NVRAM Block Rte_NvmBlock_FuelFilterChange_PM_StandardMonitor
      PS_Rte_NvmBlock_LW_PM_LastPadChange: provided-interface=NvM_AC3_SRBS_Srv_Defs  # PPort_Rte_NvmBlock_LW_PM_LastPadChange : NvM_AC3_SRBS_Srv_Defs | P-Port Prototype of NvM_AC3_SRBS_Srv_Defs for NVRAM Block Rte_NvmBlock_LW_PM_LastPadChange
      PS_Rte_NvmBlock_LW_PM_LiningWearMonitor: provided-interface=NvM_AC3_SRBS_Srv_Defs  # PPort_Rte_NvmBlock_LW_PM_LiningWearMonitor : NvM_AC3_SRBS_Srv_Defs | P-Port Prototype of NvM_AC3_SRBS_Srv_Defs for NVRAM Block Rte_NvmBlock_LW_PM_LiningWearMonitor
      PS_Rte_NvmBlock_OD_PM_OilDegradationPredictiveMonitor: provided-interface=NvM_AC3_SRBS_Srv_Defs  # PPort_Rte_NvmBlock_OD_PM_OilDegradationPredictiveMonitor : NvM_AC3_SRBS_Srv_Defs | P-Port Prototype of NvM_AC3_SRBS_Srv_Defs for NVRAM Block Rte_NvmBlock_OD_PM_OilDegradationPredictiveMonitor
      PS_Rte_NvmBlock_OD_PM_OilDegradationStandardMonitor: provided-interface=NvM_AC3_SRBS_Srv_Defs  # PPort_Rte_NvmBlock_OD_PM_OilDegradationStandardMonitor : NvM_AC3_SRBS_Srv_Defs | P-Port Prototype of NvM_AC3_SRBS_Srv_Defs for NVRAM Block Rte_NvmBlock_OD_PM_OilDegradationStandardMonitor
      PS_Rte_NvmBlock_OilFilterChange_PM_StandardMonitor: provided-interface=NvM_AC3_SRBS_Srv_Defs  # PPort_Rte_NvmBlock_OilFilterChange_PM_StandardMonitor : NvM_AC3_SRBS_Srv_Defs | P-Port Prototype of NvM_AC3_SRBS_Srv_Defs for NVRAM Block Rte_NvmBlock_OilFilterChange_PM_StandardMonitor
      PS_Rte_NvmBlock_PowerSteeringService_PM_StandardMonitor: provided-interface=NvM_AC3_SRBS_Srv_Defs  # PPort_Rte_NvmBlock_PowerSteeringService_PM_StandardMonitor : NvM_AC3_SRBS_Srv_Defs | P-Port Prototype of NvM_AC3_SRBS_Srv_Defs for NVRAM Block Rte_NvmBlock_PowerSteeringService_PM_StandardMonitor
      PS_Rte_NvmBlock_StarterBrush_PM_StandardMonitor: provided-interface=NvM_AC3_SRBS_Srv_Defs  # PPort_Rte_NvmBlock_StarterBrush_PM_StandardMonitor : NvM_AC3_SRBS_Srv_Defs | P-Port Prototype of NvM_AC3_SRBS_Srv_Defs for NVRAM Block Rte_NvmBlock_StarterBrush_PM_StandardMonitor
      PS_Rte_NvmBlock_TG_PM_TachographPredictiveMonitor: provided-interface=NvM_AC3_SRBS_Srv_Defs  # PPort_Rte_NvmBlock_TG_PM_TachographPredictiveMonitor : NvM_AC3_SRBS_Srv_Defs | P-Port Prototype of NvM_AC3_SRBS_Srv_Defs for NVRAM Block Rte_NvmBlock_TG_PM_TachographPredictiveMonitor
      PS_Rte_NvmBlock_TG_PM_TachographStandardMonitor: provided-interface=NvM_AC3_SRBS_Srv_Defs  # PPort_Rte_NvmBlock_TG_PM_TachographStandardMonitor : NvM_AC3_SRBS_Srv_Defs | P-Port Prototype of NvM_AC3_SRBS_Srv_Defs for NVRAM Block Rte_NvmBlock_TG_PM_TachographStandardMonitor
      PS_Rte_NvmBlock_TechnicalControlInspection_PM_StandardMonitor: provided-interface=NvM_AC3_SRBS_Srv_Defs  # PPort_Rte_NvmBlock_TechnicalControlInspection_PM_StandardMonitor : NvM_AC3_SRBS_Srv_Defs | P-Port Prototype of NvM_AC3_SRBS_Srv_Defs for NVRAM Block Rte_NvmBlock_TechnicalControlInspection_PM_StandardMonitor
      PS_Rte_NvmBlock_TransmissionOil_PM_StandardMonitor: provided-interface=NvM_AC3_SRBS_Srv_Defs  # PPort_Rte_NvmBlock_TransmissionOil_PM_StandardMonitor : NvM_AC3_SRBS_Srv_Defs | P-Port Prototype of NvM_AC3_SRBS_Srv_Defs for NVRAM Block Rte_NvmBlock_TransmissionOil_PM_StandardMonitor
      PS_Rte_NvmBlock_ValveLashUnitInjector_PM_StandardMonitor: provided-interface=NvM_AC3_SRBS_Srv_Defs  # PPort_Rte_NvmBlock_ValveLashUnitInjector_PM_StandardMonitor : NvM_AC3_SRBS_Srv_Defs | P-Port Prototype of NvM_AC3_SRBS_Srv_Defs for NVRAM Block Rte_NvmBlock_ValveLashUnitInjector_PM_StandardMonitor
      PS_Rte_NvmBlock_HLC_LCP_StatusMemorization: provided-interface=NvM_AC3_SRBS_Srv_Defs  # PPort_Rte_NvmBlock_HLC_LCP_StatusMemorization : NvM_AC3_SRBS_Srv_Defs | P-Port Prototype of NvM_AC3_SRBS_Srv_Defs for NVRAM Block Rte_NvmBlock_HLC_LCP_StatusMemorization
      PS_NV_EcocruiseDataGeneralData_P1GCO: provided-interface=NvM_AC3_SRBS_Srv_Defs  # PPort_NV_EcocruiseDataGeneralData_P1GCO : NvM_AC3_SRBS_Srv_Defs | P-Port Prototype of NvM_AC3_SRBS_Srv_Defs for NVRAM Block NV_EcocruiseDataGeneralData_P1GCO
      PS_NV_EcocruiseinFuelEcoActive_P1GCP: provided-interface=NvM_AC3_SRBS_Srv_Defs  # PPort_NV_EcocruiseinFuelEcoActive_P1GCP : NvM_AC3_SRBS_Srv_Defs | P-Port Prototype of NvM_AC3_SRBS_Srv_Defs for NVRAM Block NV_EcocruiseinFuelEcoActive_P1GCP
      PS_NV_EcocruiseDataPossibleBadDriverBehaviour_P1GCQ: provided-interface=NvM_AC3_SRBS_Srv_Defs  # PPort_NV_EcocruiseDataPossibleBadDriverBehaviour_P1GCQ : NvM_AC3_SRBS_Srv_Defs | P-Port Prototype of NvM_AC3_SRBS_Srv_Defs for NVRAM Block NV_EcocruiseDataPossibleBadDriverBehaviour_P1GCQ
      PS_Rte_NvmBlock_SCL_ESCLCabAndChassisAssembled: provided-interface=NvM_AC3_SRBS_Srv_Defs  # PPort_Rte_NvmBlock_SCL_ESCLCabAndChassisAssembled : NvM_AC3_SRBS_Srv_Defs | P-Port Prototype of NvM_AC3_SRBS_Srv_Defs for NVRAM Block Rte_NvmBlock_SCL_ESCLCabAndChassisAssembled
      PS_Rte_NvmBlock_DAL_prevBlackOutandConvoyMode_rqst: provided-interface=NvM_AC3_SRBS_Srv_Defs  # PPort_Rte_NvmBlock_DAL_prevBlackOutandConvoyMode_rqst : NvM_AC3_SRBS_Srv_Defs | P-Port Prototype of NvM_AC3_SRBS_Srv_Defs for NVRAM Block Rte_NvmBlock_DAL_prevBlackOutandConvoyMode_rqst
      PS_NV_LaneKeepingDriverBehaviour_P1HB2: provided-interface=NvM_AC3_SRBS_Srv_Defs  # PPort_NV_LaneKeepingDriverBehaviour_P1HB2 : NvM_AC3_SRBS_Srv_Defs | P-Port Prototype of NvM_AC3_SRBS_Srv_Defs for NVRAM Block NV_LaneKeepingDriverBehaviour_P1HB2
      PS_NV_BrakingWithBigDecelerationCounter_P1HB3: provided-interface=NvM_AC3_SRBS_Srv_Defs  # PPort_NV_BrakingWithBigDecelerationCounter_P1HB3 : NvM_AC3_SRBS_Srv_Defs | P-Port Prototype of NvM_AC3_SRBS_Srv_Defs for NVRAM Block NV_BrakingWithBigDecelerationCounter_P1HB3
      PS_NV_VehicleOverspeedLegalAndCustomer_P1HB5: provided-interface=NvM_AC3_SRBS_Srv_Defs  # PPort_NV_VehicleOverspeedLegalAndCustomer_P1HB5 : NvM_AC3_SRBS_Srv_Defs | P-Port Prototype of NvM_AC3_SRBS_Srv_Defs for NVRAM Block NV_VehicleOverspeedLegalAndCustomer_P1HB5
      PS_NV_OBDMalfunctionInformationAlert_P1G7P: provided-interface=NvM_AC3_SRBS_Srv_Defs  # PPort_NV_OBDMalfunctionInformationAlert_P1G7P : NvM_AC3_SRBS_Srv_Defs | P-Port Prototype of NvM_AC3_SRBS_Srv_Defs for NVRAM Block NV_OBDMalfunctionInformationAlert_P1G7P
      PS_NV_OBDFailureAlert_P1G7Q: provided-interface=NvM_AC3_SRBS_Srv_Defs  # PPort_NV_OBDFailureAlert_P1G7Q : NvM_AC3_SRBS_Srv_Defs | P-Port Prototype of NvM_AC3_SRBS_Srv_Defs for NVRAM Block NV_OBDFailureAlert_P1G7Q
      PS_NV_EngineOilPressureAlert_P1G7R: provided-interface=NvM_AC3_SRBS_Srv_Defs  # PPort_NV_EngineOilPressureAlert_P1G7R : NvM_AC3_SRBS_Srv_Defs | P-Port Prototype of NvM_AC3_SRBS_Srv_Defs for NVRAM Block NV_EngineOilPressureAlert_P1G7R
      PS_NV_EngineOilPressureStopAlert_P1G7S: provided-interface=NvM_AC3_SRBS_Srv_Defs  # PPort_NV_EngineOilPressureStopAlert_P1G7S : NvM_AC3_SRBS_Srv_Defs | P-Port Prototype of NvM_AC3_SRBS_Srv_Defs for NVRAM Block NV_EngineOilPressureStopAlert_P1G7S
      PS_NV_EngineDerating_P1HBN: provided-interface=NvM_AC3_SRBS_Srv_Defs  # PPort_NV_EngineDerating_P1HBN : NvM_AC3_SRBS_Srv_Defs | P-Port Prototype of NvM_AC3_SRBS_Srv_Defs for NVRAM Block NV_EngineDerating_P1HBN
      PS_NV_EngineOverspeedEOL_P1HBP: provided-interface=NvM_AC3_SRBS_Srv_Defs  # PPort_NV_EngineOverspeedEOL_P1HBP : NvM_AC3_SRBS_Srv_Defs | P-Port Prototype of NvM_AC3_SRBS_Srv_Defs for NVRAM Block NV_EngineOverspeedEOL_P1HBP
      PS_NV_EngineLowIdleSpeed_P1HBQ: provided-interface=NvM_AC3_SRBS_Srv_Defs  # PPort_NV_EngineLowIdleSpeed_P1HBQ : NvM_AC3_SRBS_Srv_Defs | P-Port Prototype of NvM_AC3_SRBS_Srv_Defs for NVRAM Block NV_EngineLowIdleSpeed_P1HBQ
      PS_NV_EngineOverspeedWithEngineBrake_P1HBR: provided-interface=NvM_AC3_SRBS_Srv_Defs  # PPort_NV_EngineOverspeedWithEngineBrake_P1HBR : NvM_AC3_SRBS_Srv_Defs | P-Port Prototype of NvM_AC3_SRBS_Srv_Defs for NVRAM Block NV_EngineOverspeedWithEngineBrake_P1HBR
      PS_NV_EngineOverspeedWhateverEngineBrakeStatus_P1HBT: provided-interface=NvM_AC3_SRBS_Srv_Defs  # PPort_NV_EngineOverspeedWhateverEngineBrakeStatus_P1HBT : NvM_AC3_SRBS_Srv_Defs | P-Port Prototype of NvM_AC3_SRBS_Srv_Defs for NVRAM Block NV_EngineOverspeedWhateverEngineBrakeStatus_P1HBT
      PS_NV_EngineOverspeedCustomer_P1HBU: provided-interface=NvM_AC3_SRBS_Srv_Defs  # PPort_NV_EngineOverspeedCustomer_P1HBU : NvM_AC3_SRBS_Srv_Defs | P-Port Prototype of NvM_AC3_SRBS_Srv_Defs for NVRAM Block NV_EngineOverspeedCustomer_P1HBU
      PS_NV_TotalVehicleWeightLoggingParameters_P1G7O: provided-interface=NvM_AC3_SRBS_Srv_Defs  # PPort_NV_TotalVehicleWeightLoggingParameters_P1G7O : NvM_AC3_SRBS_Srv_Defs | P-Port Prototype of NvM_AC3_SRBS_Srv_Defs for NVRAM Block NV_TotalVehicleWeightLoggingParameters_P1G7O
      PS_NV_InGreenArea_P1HBV: provided-interface=NvM_AC3_SRBS_Srv_Defs  # PPort_NV_InGreenArea_P1HBV : NvM_AC3_SRBS_Srv_Defs | P-Port Prototype of NvM_AC3_SRBS_Srv_Defs for NVRAM Block NV_InGreenArea_P1HBV
      PS_NV_OutOfGreenArea_P1HBW: provided-interface=NvM_AC3_SRBS_Srv_Defs  # PPort_NV_OutOfGreenArea_P1HBW : NvM_AC3_SRBS_Srv_Defs | P-Port Prototype of NvM_AC3_SRBS_Srv_Defs for NVRAM Block NV_OutOfGreenArea_P1HBW
      PS_NV_AdblueConsumption_P1HBY: provided-interface=NvM_AC3_SRBS_Srv_Defs  # PPort_NV_AdblueConsumption_P1HBY : NvM_AC3_SRBS_Srv_Defs | P-Port Prototype of NvM_AC3_SRBS_Srv_Defs for NVRAM Block NV_AdblueConsumption_P1HBY
      PS_NV_AdblueLowLevelTank_P1HBZ: provided-interface=NvM_AC3_SRBS_Srv_Defs  # PPort_NV_AdblueLowLevelTank_P1HBZ : NvM_AC3_SRBS_Srv_Defs | P-Port Prototype of NvM_AC3_SRBS_Srv_Defs for NVRAM Block NV_AdblueLowLevelTank_P1HBZ
      PS_NV_AdblueHighTemperature_P1HB0: provided-interface=NvM_AC3_SRBS_Srv_Defs  # PPort_NV_AdblueHighTemperature_P1HB0 : NvM_AC3_SRBS_Srv_Defs | P-Port Prototype of NvM_AC3_SRBS_Srv_Defs for NVRAM Block NV_AdblueHighTemperature_P1HB0
      PS_NV_AdblueLowTemperature_P1HB1: provided-interface=NvM_AC3_SRBS_Srv_Defs  # PPort_NV_AdblueLowTemperature_P1HB1 : NvM_AC3_SRBS_Srv_Defs | P-Port Prototype of NvM_AC3_SRBS_Srv_Defs for NVRAM Block NV_AdblueLowTemperature_P1HB1
      PS_NV_EngineCoolantTemperatureAndLevelEventLogs_P1HBO: provided-interface=NvM_AC3_SRBS_Srv_Defs  # PPort_NV_EngineCoolantTemperatureAndLevelEventLogs_P1HBO : NvM_AC3_SRBS_Srv_Defs | P-Port Prototype of NvM_AC3_SRBS_Srv_Defs for NVRAM Block NV_EngineCoolantTemperatureAndLevelEventLogs_P1HBO
      PS_NV_PTOUseLoggingData_P1G7N: provided-interface=NvM_AC3_SRBS_Srv_Defs  # PPort_NV_PTOUseLoggingData_P1G7N : NvM_AC3_SRBS_Srv_Defs | P-Port Prototype of NvM_AC3_SRBS_Srv_Defs for NVRAM Block NV_PTOUseLoggingData_P1G7N
      PS_NV_NoDriverCardInTheTachograph_P1G7J: provided-interface=NvM_AC3_SRBS_Srv_Defs  # PPort_NV_NoDriverCardInTheTachograph_P1G7J : NvM_AC3_SRBS_Srv_Defs | P-Port Prototype of NvM_AC3_SRBS_Srv_Defs for NVRAM Block NV_NoDriverCardInTheTachograph_P1G7J
      PS_NV_SeatBeltDriverUsage_P1G7M: provided-interface=NvM_AC3_SRBS_Srv_Defs  # PPort_NV_SeatBeltDriverUsage_P1G7M : NvM_AC3_SRBS_Srv_Defs | P-Port Prototype of NvM_AC3_SRBS_Srv_Defs for NVRAM Block NV_SeatBeltDriverUsage_P1G7M
      PS_NV_BatteryData_P1HB6: provided-interface=NvM_AC3_SRBS_Srv_Defs  # PPort_NV_BatteryData_P1HB6 : NvM_AC3_SRBS_Srv_Defs | P-Port Prototype of NvM_AC3_SRBS_Srv_Defs for NVRAM Block NV_BatteryData_P1HB6
      PS_NV_BatteryData3_P1HB8: provided-interface=NvM_AC3_SRBS_Srv_Defs  # PPort_NV_BatteryData3_P1HB8 : NvM_AC3_SRBS_Srv_Defs | P-Port Prototype of NvM_AC3_SRBS_Srv_Defs for NVRAM Block NV_BatteryData3_P1HB8
      PS_NV_CruiseControlWithRetarder_P1HCA: provided-interface=NvM_AC3_SRBS_Srv_Defs  # PPort_NV_CruiseControlWithRetarder_P1HCA : NvM_AC3_SRBS_Srv_Defs | P-Port Prototype of NvM_AC3_SRBS_Srv_Defs for NVRAM Block NV_CruiseControlWithRetarder_P1HCA
      PS_NV_CruiseControlOverspeedInDownhill_P1HCB: provided-interface=NvM_AC3_SRBS_Srv_Defs  # PPort_NV_CruiseControlOverspeedInDownhill_P1HCB : NvM_AC3_SRBS_Srv_Defs | P-Port Prototype of NvM_AC3_SRBS_Srv_Defs for NVRAM Block NV_CruiseControlOverspeedInDownhill_P1HCB
      PS_NV_CruiseControlOverEngineLoad_P1HCC: provided-interface=NvM_AC3_SRBS_Srv_Defs  # PPort_NV_CruiseControlOverEngineLoad_P1HCC : NvM_AC3_SRBS_Srv_Defs | P-Port Prototype of NvM_AC3_SRBS_Srv_Defs for NVRAM Block NV_CruiseControlOverEngineLoad_P1HCC
      PS_NV_CruiseControlHistogram_P1HCD: provided-interface=NvM_AC3_SRBS_Srv_Defs  # PPort_NV_CruiseControlHistogram_P1HCD : NvM_AC3_SRBS_Srv_Defs | P-Port Prototype of NvM_AC3_SRBS_Srv_Defs for NVRAM Block NV_CruiseControlHistogram_P1HCD
      PS_NV_CruiseControlGeneralData_P1HCE: provided-interface=NvM_AC3_SRBS_Srv_Defs  # PPort_NV_CruiseControlGeneralData_P1HCE : NvM_AC3_SRBS_Srv_Defs | P-Port Prototype of NvM_AC3_SRBS_Srv_Defs for NVRAM Block NV_CruiseControlGeneralData_P1HCE
      PS_NV_ASRData_P1HDZ: provided-interface=NvM_AC3_SRBS_Srv_Defs  # PPort_NV_ASRData_P1HDZ : NvM_AC3_SRBS_Srv_Defs | P-Port Prototype of NvM_AC3_SRBS_Srv_Defs for NVRAM Block NV_ASRData_P1HDZ
      PS_NV_BrakingAndRetarderData_P1HD4: provided-interface=NvM_AC3_SRBS_Srv_Defs  # PPort_NV_BrakingAndRetarderData_P1HD4 : NvM_AC3_SRBS_Srv_Defs | P-Port Prototype of NvM_AC3_SRBS_Srv_Defs for NVRAM Block NV_BrakingAndRetarderData_P1HD4
      PS_NV_EngineOverload_P1HD5: provided-interface=NvM_AC3_SRBS_Srv_Defs  # PPort_NV_EngineOverload_P1HD5 : NvM_AC3_SRBS_Srv_Defs | P-Port Prototype of NvM_AC3_SRBS_Srv_Defs for NVRAM Block NV_EngineOverload_P1HD5
      PS_NV_RobotizedGearbox_P1HD6: provided-interface=NvM_AC3_SRBS_Srv_Defs  # PPort_NV_RobotizedGearbox_P1HD6 : NvM_AC3_SRBS_Srv_Defs | P-Port Prototype of NvM_AC3_SRBS_Srv_Defs for NVRAM Block NV_RobotizedGearbox_P1HD6
      PS_NV_Coasting_P1HD7: provided-interface=NvM_AC3_SRBS_Srv_Defs  # PPort_NV_Coasting_P1HD7 : NvM_AC3_SRBS_Srv_Defs | P-Port Prototype of NvM_AC3_SRBS_Srv_Defs for NVRAM Block NV_Coasting_P1HD7
      PS_NV_EngineFuelHistograms_P1HD8: provided-interface=NvM_AC3_SRBS_Srv_Defs  # PPort_NV_EngineFuelHistograms_P1HD8 : NvM_AC3_SRBS_Srv_Defs | P-Port Prototype of NvM_AC3_SRBS_Srv_Defs for NVRAM Block NV_EngineFuelHistograms_P1HD8
      PS_NV_EngineFuelConsumptionGeneralData_P1HD9: provided-interface=NvM_AC3_SRBS_Srv_Defs  # PPort_NV_EngineFuelConsumptionGeneralData_P1HD9 : NvM_AC3_SRBS_Srv_Defs | P-Port Prototype of NvM_AC3_SRBS_Srv_Defs for NVRAM Block NV_EngineFuelConsumptionGeneralData_P1HD9
      PS_NV_EngineRetarderCounters_P1HEA: provided-interface=NvM_AC3_SRBS_Srv_Defs  # PPort_NV_EngineRetarderCounters_P1HEA : NvM_AC3_SRBS_Srv_Defs | P-Port Prototype of NvM_AC3_SRBS_Srv_Defs for NVRAM Block NV_EngineRetarderCounters_P1HEA
      PS_NV_EngineRetarderHistograms_P1HEB: provided-interface=NvM_AC3_SRBS_Srv_Defs  # PPort_NV_EngineRetarderHistograms_P1HEB : NvM_AC3_SRBS_Srv_Defs | P-Port Prototype of NvM_AC3_SRBS_Srv_Defs for NVRAM Block NV_EngineRetarderHistograms_P1HEB
      PS_NV_VehicleOverspeed_P1HEC: provided-interface=NvM_AC3_SRBS_Srv_Defs  # PPort_NV_VehicleOverspeed_P1HEC : NvM_AC3_SRBS_Srv_Defs | P-Port Prototype of NvM_AC3_SRBS_Srv_Defs for NVRAM Block NV_VehicleOverspeed_P1HEC
      PS_NV_EngineTimeHistograms_P1HFG: provided-interface=NvM_AC3_SRBS_Srv_Defs  # PPort_NV_EngineTimeHistograms_P1HFG : NvM_AC3_SRBS_Srv_Defs | P-Port Prototype of NvM_AC3_SRBS_Srv_Defs for NVRAM Block NV_EngineTimeHistograms_P1HFG
      PS_NV_LiftAxlesUse_P1HFK: provided-interface=NvM_AC3_SRBS_Srv_Defs  # PPort_NV_LiftAxlesUse_P1HFK : NvM_AC3_SRBS_Srv_Defs | P-Port Prototype of NvM_AC3_SRBS_Srv_Defs for NVRAM Block NV_LiftAxlesUse_P1HFK
      PS_NV_AirConditioning_P1HGT: provided-interface=NvM_AC3_SRBS_Srv_Defs  # PPort_NV_AirConditioning_P1HGT : NvM_AC3_SRBS_Srv_Defs | P-Port Prototype of NvM_AC3_SRBS_Srv_Defs for NVRAM Block NV_AirConditioning_P1HGT
      PS_NV_DrivelineRetarderLoggingData_P1HGU: provided-interface=NvM_AC3_SRBS_Srv_Defs  # PPort_NV_DrivelineRetarderLoggingData_P1HGU : NvM_AC3_SRBS_Srv_Defs | P-Port Prototype of NvM_AC3_SRBS_Srv_Defs for NVRAM Block NV_DrivelineRetarderLoggingData_P1HGU
      PS_NV_TractorTrailerBrakingHarmonization_P1HGV: provided-interface=NvM_AC3_SRBS_Srv_Defs  # PPort_NV_TractorTrailerBrakingHarmonization_P1HGV : NvM_AC3_SRBS_Srv_Defs | P-Port Prototype of NvM_AC3_SRBS_Srv_Defs for NVRAM Block NV_TractorTrailerBrakingHarmonization_P1HGV
      PS_NV_AirCompressor_P1HGW: provided-interface=NvM_AC3_SRBS_Srv_Defs  # PPort_NV_AirCompressor_P1HGW : NvM_AC3_SRBS_Srv_Defs | P-Port Prototype of NvM_AC3_SRBS_Srv_Defs for NVRAM Block NV_AirCompressor_P1HGW
      PS_NV_EngineStartInBackupMode_P1HGX: provided-interface=NvM_AC3_SRBS_Srv_Defs  # PPort_NV_EngineStartInBackupMode_P1HGX : NvM_AC3_SRBS_Srv_Defs | P-Port Prototype of NvM_AC3_SRBS_Srv_Defs for NVRAM Block NV_EngineStartInBackupMode_P1HGX
      PS_NV_DrivingMonitoringSystem_P1HGY: provided-interface=NvM_AC3_SRBS_Srv_Defs  # PPort_NV_DrivingMonitoringSystem_P1HGY : NvM_AC3_SRBS_Srv_Defs | P-Port Prototype of NvM_AC3_SRBS_Srv_Defs for NVRAM Block NV_DrivingMonitoringSystem_P1HGY
      PS_NV_VehicleModesData_P1HGZ: provided-interface=NvM_AC3_SRBS_Srv_Defs  # PPort_NV_VehicleModesData_P1HGZ : NvM_AC3_SRBS_Srv_Defs | P-Port Prototype of NvM_AC3_SRBS_Srv_Defs for NVRAM Block NV_VehicleModesData_P1HGZ
      PS_NV_IgnitionLogging_P1HG0: provided-interface=NvM_AC3_SRBS_Srv_Defs  # PPort_NV_IgnitionLogging_P1HG0 : NvM_AC3_SRBS_Srv_Defs | P-Port Prototype of NvM_AC3_SRBS_Srv_Defs for NVRAM Block NV_IgnitionLogging_P1HG0
      PS_NV_FifthWheel_P1HG2: provided-interface=NvM_AC3_SRBS_Srv_Defs  # PPort_NV_FifthWheel_P1HG2 : NvM_AC3_SRBS_Srv_Defs | P-Port Prototype of NvM_AC3_SRBS_Srv_Defs for NVRAM Block NV_FifthWheel_P1HG2
      PS_NV_EngineTrueIdleSpeed_P1HG4: provided-interface=NvM_AC3_SRBS_Srv_Defs  # PPort_NV_EngineTrueIdleSpeed_P1HG4 : NvM_AC3_SRBS_Srv_Defs | P-Port Prototype of NvM_AC3_SRBS_Srv_Defs for NVRAM Block NV_EngineTrueIdleSpeed_P1HG4
      PS_NV_ABSData_P1HG8: provided-interface=NvM_AC3_SRBS_Srv_Defs  # PPort_NV_ABSData_P1HG8 : NvM_AC3_SRBS_Srv_Defs | P-Port Prototype of NvM_AC3_SRBS_Srv_Defs for NVRAM Block NV_ABSData_P1HG8
      PS_NV_VehicleMotion_P1HG6: provided-interface=NvM_AC3_SRBS_Srv_Defs  # PPort_NV_VehicleMotion_P1HG6 : NvM_AC3_SRBS_Srv_Defs | P-Port Prototype of NvM_AC3_SRBS_Srv_Defs for NVRAM Block NV_VehicleMotion_P1HG6
      PS_NV_ParkBrakeData_P1HG7: provided-interface=NvM_AC3_SRBS_Srv_Defs  # PPort_NV_ParkBrakeData_P1HG7 : NvM_AC3_SRBS_Srv_Defs | P-Port Prototype of NvM_AC3_SRBS_Srv_Defs for NVRAM Block NV_ParkBrakeData_P1HG7
      PS_NV_LinearClutchPedalSensorEndPos_P1HIR: provided-interface=NvM_AC3_SRBS_Srv_Defs  # PPort_NV_LinearClutchPedalSensorEndPos_P1HIR : NvM_AC3_SRBS_Srv_Defs | P-Port Prototype of NvM_AC3_SRBS_Srv_Defs for NVRAM Block NV_LinearClutchPedalSensorEndPos_P1HIR
      PS_Rte_NvmBlock_OBL_Admin: provided-interface=NvM_AC3_SRBS_Srv_Defs  # PPort_Rte_NvmBlock_OBL_Admin : NvM_AC3_SRBS_Srv_Defs | P-Port Prototype of NvM_AC3_SRBS_Srv_Defs for NVRAM Block Rte_NvmBlock_OBL_Admin
      PS_Rte_NvmBlock_OPL_Admin: provided-interface=NvM_AC3_SRBS_Srv_Defs  # PPort_Rte_NvmBlock_OPL_Admin : NvM_AC3_SRBS_Srv_Defs | P-Port Prototype of NvM_AC3_SRBS_Srv_Defs for NVRAM Block Rte_NvmBlock_OPL_Admin
      PS_NV_BrakeAssistData_P1HOE: provided-interface=NvM_AC3_SRBS_Srv_Defs  # PPort_NV_BrakeAssistData_P1HOE : NvM_AC3_SRBS_Srv_Defs | P-Port Prototype of NvM_AC3_SRBS_Srv_Defs for NVRAM Block NV_BrakeAssistData_P1HOE
      PS_NV_LaneKeepingDriverImpairment_P1HOF: provided-interface=NvM_AC3_SRBS_Srv_Defs  # PPort_NV_LaneKeepingDriverImpairment_P1HOF : NvM_AC3_SRBS_Srv_Defs | P-Port Prototype of NvM_AC3_SRBS_Srv_Defs for NVRAM Block NV_LaneKeepingDriverImpairment_P1HOF
      PS_NV_ESPData_P1HOG: provided-interface=NvM_AC3_SRBS_Srv_Defs  # PPort_NV_ESPData_P1HOG : NvM_AC3_SRBS_Srv_Defs | P-Port Prototype of NvM_AC3_SRBS_Srv_Defs for NVRAM Block NV_ESPData_P1HOG
      PS_NV_BatteryData2_P1HOH: provided-interface=NvM_AC3_SRBS_Srv_Defs  # PPort_NV_BatteryData2_P1HOH : NvM_AC3_SRBS_Srv_Defs | P-Port Prototype of NvM_AC3_SRBS_Srv_Defs for NVRAM Block NV_BatteryData2_P1HOH
      PS_NV_VehicleTechnicalStatusIgnoredByDriver_P1HOI: provided-interface=NvM_AC3_SRBS_Srv_Defs  # PPort_NV_VehicleTechnicalStatusIgnoredByDriver_P1HOI : NvM_AC3_SRBS_Srv_Defs | P-Port Prototype of NvM_AC3_SRBS_Srv_Defs for NVRAM Block NV_VehicleTechnicalStatusIgnoredByDriver_P1HOI
      PS_NV_NotEngagedParkBrakeWhenDriverOutsideTheVehicle_P1HOJ: provided-interface=NvM_AC3_SRBS_Srv_Defs  # PPort_NV_NotEngagedParkBrakeWhenDriverOutsideTheVehicle_P1HOJ : NvM_AC3_SRBS_Srv_Defs | P-Port Prototype of NvM_AC3_SRBS_Srv_Defs for NVRAM Block NV_NotEngagedParkBrakeWhenDriverOutsideTheVehicle_P1HOJ
      PS_NV_LoadIndication_P1HOK: provided-interface=NvM_AC3_SRBS_Srv_Defs  # PPort_NV_LoadIndication_P1HOK : NvM_AC3_SRBS_Srv_Defs | P-Port Prototype of NvM_AC3_SRBS_Srv_Defs for NVRAM Block NV_LoadIndication_P1HOK
      PS_NV_IntakeAirOverheatAlertEvent_P1HOL: provided-interface=NvM_AC3_SRBS_Srv_Defs  # PPort_NV_IntakeAirOverheatAlertEvent_P1HOL : NvM_AC3_SRBS_Srv_Defs | P-Port Prototype of NvM_AC3_SRBS_Srv_Defs for NVRAM Block NV_IntakeAirOverheatAlertEvent_P1HOL
      PS_NV_EngineOverspeedWithoutEngineBrake_P1HOM: provided-interface=NvM_AC3_SRBS_Srv_Defs  # PPort_NV_EngineOverspeedWithoutEngineBrake_P1HOM : NvM_AC3_SRBS_Srv_Defs | P-Port Prototype of NvM_AC3_SRBS_Srv_Defs for NVRAM Block NV_EngineOverspeedWithoutEngineBrake_P1HOM
      PS_Rte_NvmBlock_OBDDP_DrivingCycleActive: provided-interface=NvM_AC3_SRBS_Srv_Defs  # PPort_Rte_NvmBlock_OBDDP_DrivingCycleActive : NvM_AC3_SRBS_Srv_Defs | P-Port Prototype of NvM_AC3_SRBS_Srv_Defs for NVRAM Block Rte_NvmBlock_OBDDP_DrivingCycleActive
      PS_NV_CollisionMitigationData_P1HTK: provided-interface=NvM_AC3_SRBS_Srv_Defs  # PPort_NV_CollisionMitigationData_P1HTK : NvM_AC3_SRBS_Srv_Defs | P-Port Prototype of NvM_AC3_SRBS_Srv_Defs for NVRAM Block NV_CollisionMitigationData_P1HTK
      PS_NV_DiagnosticData_P1H52: provided-interface=NvM_AC3_SRBS_Srv_Defs  # PPort_NV_DiagnosticData_P1H52 : NvM_AC3_SRBS_Srv_Defs | P-Port Prototype of NvM_AC3_SRBS_Srv_Defs for NVRAM Block NV_DiagnosticData_P1H52
      PS_NV_AirIntake_P1H98: provided-interface=NvM_AC3_SRBS_Srv_Defs  # PPort_NV_AirIntake_P1H98 : NvM_AC3_SRBS_Srv_Defs | P-Port Prototype of NvM_AC3_SRBS_Srv_Defs for NVRAM Block NV_AirIntake_P1H98
      PS_NV_EngineCoolantTemperatureAndLevelServiceAlert_P1H99: provided-interface=NvM_AC3_SRBS_Srv_Defs  # PPort_NV_EngineCoolantTemperatureAndLevelServiceAlert_P1H99 : NvM_AC3_SRBS_Srv_Defs | P-Port Prototype of NvM_AC3_SRBS_Srv_Defs for NVRAM Block NV_EngineCoolantTemperatureAndLevelServiceAlert_P1H99
      PS_NV_EngineCoolantTemperatureAndLevelStopAlert_P1IAA: provided-interface=NvM_AC3_SRBS_Srv_Defs  # PPort_NV_EngineCoolantTemperatureAndLevelStopAlert_P1IAA : NvM_AC3_SRBS_Srv_Defs | P-Port Prototype of NvM_AC3_SRBS_Srv_Defs for NVRAM Block NV_EngineCoolantTemperatureAndLevelStopAlert_P1IAA
      PS_Rte_NvmBlock_AD_ACDData: provided-interface=NvM_AC3_SRBS_Srv_Defs  # PPort_Rte_NvmBlock_AD_ACDData : NvM_AC3_SRBS_Srv_Defs | P-Port Prototype of NvM_AC3_SRBS_Srv_Defs for NVRAM Block Rte_NvmBlock_AD_ACDData
      PS_Rte_NvmBlock_IKeyMapper_IgnitionKeyPosition: provided-interface=NvM_AC3_SRBS_Srv_Defs  # PPort_Rte_NvmBlock_IKeyMapper_IgnitionKeyPosition : NvM_AC3_SRBS_Srv_Defs | P-Port Prototype of NvM_AC3_SRBS_Srv_Defs for NVRAM Block Rte_NvmBlock_IKeyMapper_IgnitionKeyPosition
      PS_Rte_NvmBlock_SCL_ESCLData: provided-interface=NvM_AC3_SRBS_Srv_Defs  # PPort_Rte_NvmBlock_SCL_ESCLData : NvM_AC3_SRBS_Srv_Defs | P-Port Prototype of NvM_AC3_SRBS_Srv_Defs for NVRAM Block Rte_NvmBlock_SCL_ESCLData
      PS_Rte_NvmBlock_OBL_OBDContinuousMIAlert_P1ITL: provided-interface=NvM_AC3_SRBS_Srv_Defs  # PPort_Rte_NvmBlock_OBL_OBDContinuousMIAlert_P1ITL : NvM_AC3_SRBS_Srv_Defs | P-Port Prototype of NvM_AC3_SRBS_Srv_Defs for NVRAM Block Rte_NvmBlock_OBL_OBDContinuousMIAlert_P1ITL
      PS_Rte_NvmBlock_OBL_OBDOnDemandMIAlert_P1ITJ: provided-interface=NvM_AC3_SRBS_Srv_Defs  # PPort_Rte_NvmBlock_OBL_OBDOnDemandMIAlert_P1ITJ : NvM_AC3_SRBS_Srv_Defs | P-Port Prototype of NvM_AC3_SRBS_Srv_Defs for NVRAM Block Rte_NvmBlock_OBL_OBDOnDemandMIAlert_P1ITJ
      PS_Rte_NvmBlock_OBL_OBDShortMIAlert_P1ITK: provided-interface=NvM_AC3_SRBS_Srv_Defs  # PPort_Rte_NvmBlock_OBL_OBDShortMIAlert_P1ITK : NvM_AC3_SRBS_Srv_Defs | P-Port Prototype of NvM_AC3_SRBS_Srv_Defs for NVRAM Block Rte_NvmBlock_OBL_OBDShortMIAlert_P1ITK
      PS_Rte_NvmBlock_OBDDP_ESCAN00058605: provided-interface=NvM_AC3_SRBS_Srv_Defs  # PPort_Rte_NvmBlock_OBDDP_ESCAN00058605 : NvM_AC3_SRBS_Srv_Defs | P-Port Prototype of NvM_AC3_SRBS_Srv_Defs for NVRAM Block Rte_NvmBlock_OBDDP_ESCAN00058605
      PS_Rte_NvmBlock_VM_VM_VehicleMode_Pim: provided-interface=NvM_AC3_SRBS_Srv_Defs  # PPort_Rte_NvmBlock_VM_VM_VehicleMode_Pim : NvM_AC3_SRBS_Srv_Defs | P-Port Prototype of NvM_AC3_SRBS_Srv_Defs for NVRAM Block Rte_NvmBlock_VM_VM_VehicleMode_Pim
      PAdmin_ConfigBlock: provided-interface=NvM_Administration  # PPort_ConfigBlock : NvM_Administration | P-Port Prototype of NvM_Administration for NVRAM Block ConfigBlock
      PAdmin_VS_nv_KFactor: provided-interface=NvM_Administration  # PPort_VS_nv_KFactor : NvM_Administration | P-Port Prototype of NvM_Administration for NVRAM Block VS_nv_KFactor
      PAdmin_ExtraLights_BlackOutMgr_ElcBlackOutManager_States: provided-interface=NvM_Administration  # PPort_ExtraLights_BlackOutMgr_ElcBlackOutManager_States : NvM_Administration | P-Port Prototype of NvM_Administration for NVRAM Block ExtraLights_BlackOutMgr_ElcBlackOutManager_States
      PAdmin_MaxLightCircuit_maxLightIntensityLevel: provided-interface=NvM_Administration  # PPort_MaxLightCircuit_maxLightIntensityLevel : NvM_Administration | P-Port Prototype of NvM_Administration for NVRAM Block MaxLightCircuit_maxLightIntensityLevel
      PAdmin_NightLightCircuit_nightLightIntensityLevel: provided-interface=NvM_Administration  # PPort_NightLightCircuit_nightLightIntensityLevel : NvM_Administration | P-Port Prototype of NvM_Administration for NVRAM Block NightLightCircuit_nightLightIntensityLevel
      PAdmin_RequestManager_IL3_ActiveMode: provided-interface=NvM_Administration  # PPort_RequestManager_IL3_ActiveMode : NvM_Administration | P-Port Prototype of NvM_Administration for NVRAM Block RequestManager_IL3_ActiveMode
      PAdmin_RestingLightCircuit_restingLightIntensityLevel: provided-interface=NvM_Administration  # PPort_RestingLightCircuit_restingLightIntensityLevel : NvM_Administration | P-Port Prototype of NvM_Administration for NVRAM Block RestingLightCircuit_restingLightIntensityLevel
      PAdmin_EL2_BlackOutMgr_EL2_BlackOutMgrState: provided-interface=NvM_Administration  # PPort_EL2_BlackOutMgr_EL2_BlackOutMgrState : NvM_Administration | P-Port Prototype of NvM_Administration for NVRAM Block EL2_BlackOutMgr_EL2_BlackOutMgrState
      PAdmin_EX_HMI_ELH_Storage: provided-interface=NvM_Administration  # PPort_EX_HMI_ELH_Storage : NvM_Administration | P-Port Prototype of NvM_Administration for NVRAM Block EX_HMI_ELH_Storage
      PAdmin_Rte_NvmBlock_BatteryLog_BCLBatteryTimeSOCHisto_log: provided-interface=NvM_Administration  # PPort_Rte_NvmBlock_BatteryLog_BCLBatteryTimeSOCHisto_log : NvM_Administration | P-Port Prototype of NvM_Administration for NVRAM Block Rte_NvmBlock_BatteryLog_BCLBatteryTimeSOCHisto_log
      PAdmin_Rte_NvmBlock_IARL_IarEngineTimeHistogramPeriods: provided-interface=NvM_Administration  # PPort_Rte_NvmBlock_IARL_IarEngineTimeHistogramPeriods : NvM_Administration | P-Port Prototype of NvM_Administration for NVRAM Block Rte_NvmBlock_IARL_IarEngineTimeHistogramPeriods
      PAdmin_Rte_NvmBlock_VSGL_TLVehicleStartConditionCounterStartingGearHisto_log: provided-interface=NvM_Administration  # PPort_Rte_NvmBlock_VSGL_TLVehicleStartConditionCounterStartingGearHisto_log : NvM_Administration | P-Port Prototype of NvM_Administration for NVRAM Block Rte_NvmBlock_VSGL_TLVehicleStartConditionCounterStartingGearHisto_log
      PAdmin_NV_AccDistPrimNVM: provided-interface=NvM_Administration  # PPort_NV_AccDistPrimNVM : NvM_Administration | P-Port Prototype of NvM_Administration for NVRAM Block NV_AccDistPrimNVM
      PAdmin_NV_AccDistSecndNVM: provided-interface=NvM_Administration  # PPort_NV_AccDistSecndNVM : NvM_Administration | P-Port Prototype of NvM_Administration for NVRAM Block NV_AccDistSecndNVM
      PAdmin_NV_TripDist1NVM: provided-interface=NvM_Administration  # PPort_NV_TripDist1NVM : NvM_Administration | P-Port Prototype of NvM_Administration for NVRAM Block NV_TripDist1NVM
      PAdmin_NV_TripDist2NVM: provided-interface=NvM_Administration  # PPort_NV_TripDist2NVM : NvM_Administration | P-Port Prototype of NvM_Administration for NVRAM Block NV_TripDist2NVM
      PAdmin_NV_DiagmaxResDataNVM: provided-interface=NvM_Administration  # PPort_NV_DiagmaxResDataNVM : NvM_Administration | P-Port Prototype of NvM_Administration for NVRAM Block NV_DiagmaxResDataNVM
      PAdmin_Rte_NvmBlock_WWHMI_RainSensorStatus: provided-interface=NvM_Administration  # PPort_Rte_NvmBlock_WWHMI_RainSensorStatus : NvM_Administration | P-Port Prototype of NvM_Administration for NVRAM Block Rte_NvmBlock_WWHMI_RainSensorStatus
      PAdmin_Rte_NvmBlock_CCM_DriverSettingsStored: provided-interface=NvM_Administration  # PPort_Rte_NvmBlock_CCM_DriverSettingsStored : NvM_Administration | P-Port Prototype of NvM_Administration for NVRAM Block Rte_NvmBlock_CCM_DriverSettingsStored
      PAdmin_Rte_NvmBlock_RSL_TRSLTargetSpeed: provided-interface=NvM_Administration  # PPort_Rte_NvmBlock_RSL_TRSLTargetSpeed : NvM_Administration | P-Port Prototype of NvM_Administration for NVRAM Block Rte_NvmBlock_RSL_TRSLTargetSpeed
      PAdmin_Rte_NvmBlock_KeyAuthentication_KeyAuthenticationContactToImmo: provided-interface=NvM_Administration  # PPort_Rte_NvmBlock_KeyAuthentication_KeyAuthenticationContactToImmo : NvM_Administration | P-Port Prototype of NvM_Administration for NVRAM Block Rte_NvmBlock_KeyAuthentication_KeyAuthenticationContactToImmo
      PAdmin_Rte_NvmBlock_ADCL_PM_AirDryerCartridgeLogging: provided-interface=NvM_Administration  # PPort_Rte_NvmBlock_ADCL_PM_AirDryerCartridgeLogging : NvM_Administration | P-Port Prototype of NvM_Administration for NVRAM Block Rte_NvmBlock_ADCL_PM_AirDryerCartridgeLogging
      PAdmin_Rte_NvmBlock_ADC_PM_AirDryerCartridgeMonitor: provided-interface=NvM_Administration  # PPort_Rte_NvmBlock_ADC_PM_AirDryerCartridgeMonitor : NvM_Administration | P-Port Prototype of NvM_Administration for NVRAM Block Rte_NvmBlock_ADC_PM_AirDryerCartridgeMonitor
      PAdmin_Rte_NvmBlock_AirFilter_PM_StandardMonitor: provided-interface=NvM_Administration  # PPort_Rte_NvmBlock_AirFilter_PM_StandardMonitor : NvM_Administration | P-Port Prototype of NvM_Administration for NVRAM Block Rte_NvmBlock_AirFilter_PM_StandardMonitor
      PAdmin_Rte_NvmBlock_AlternatorBrush_PM_StandardMonitor: provided-interface=NvM_Administration  # PPort_Rte_NvmBlock_AlternatorBrush_PM_StandardMonitor : NvM_Administration | P-Port Prototype of NvM_Administration for NVRAM Block Rte_NvmBlock_AlternatorBrush_PM_StandardMonitor
      PAdmin_Rte_NvmBlock_AxleOil_PM_StandardMonitor: provided-interface=NvM_Administration  # PPort_Rte_NvmBlock_AxleOil_PM_StandardMonitor : NvM_Administration | P-Port Prototype of NvM_Administration for NVRAM Block Rte_NvmBlock_AxleOil_PM_StandardMonitor
      PAdmin_Rte_NvmBlock_BSOH_PM_BatterySOHMonitor: provided-interface=NvM_Administration  # PPort_Rte_NvmBlock_BSOH_PM_BatterySOHMonitor : NvM_Administration | P-Port Prototype of NvM_Administration for NVRAM Block Rte_NvmBlock_BSOH_PM_BatterySOHMonitor
      PAdmin_Rte_NvmBlock_BrakePads_PM_StandardMonitor: provided-interface=NvM_Administration  # PPort_Rte_NvmBlock_BrakePads_PM_StandardMonitor : NvM_Administration | P-Port Prototype of NvM_Administration for NVRAM Block Rte_NvmBlock_BrakePads_PM_StandardMonitor
      PAdmin_Rte_NvmBlock_ChassisLubrification_PM_StandardMonitor: provided-interface=NvM_Administration  # PPort_Rte_NvmBlock_ChassisLubrification_PM_StandardMonitor : NvM_Administration | P-Port Prototype of NvM_Administration for NVRAM Block Rte_NvmBlock_ChassisLubrification_PM_StandardMonitor
      PAdmin_Rte_NvmBlock_Clutch_PM_StandardMonitor: provided-interface=NvM_Administration  # PPort_Rte_NvmBlock_Clutch_PM_StandardMonitor : NvM_Administration | P-Port Prototype of NvM_Administration for NVRAM Block Rte_NvmBlock_Clutch_PM_StandardMonitor
      PAdmin_Rte_NvmBlock_CoolantConditionerChange_PM_StandardMonitor: provided-interface=NvM_Administration  # PPort_Rte_NvmBlock_CoolantConditionerChange_PM_StandardMonitor : NvM_Administration | P-Port Prototype of NvM_Administration for NVRAM Block Rte_NvmBlock_CoolantConditionerChange_PM_StandardMonitor
      PAdmin_Rte_NvmBlock_Coolant_PM_StandardMonitor: provided-interface=NvM_Administration  # PPort_Rte_NvmBlock_Coolant_PM_StandardMonitor : NvM_Administration | P-Port Prototype of NvM_Administration for NVRAM Block Rte_NvmBlock_Coolant_PM_StandardMonitor
      PAdmin_Rte_NvmBlock_Customer{1..4}_PM_StandardMonitor: provided-interface=NvM_Administration  # PPort_Rte_NvmBlock_Customer{1..4}_PM_StandardMonitor : NvM_Administration | P-Port Prototype of NvM_Administration for NVRAM Block Rte_NvmBlock_Customer{1..4}_PM_StandardMonitor
      PAdmin_Rte_NvmBlock_DPFAshCleaning_PM_StandardMonitor: provided-interface=NvM_Administration  # PPort_Rte_NvmBlock_DPFAshCleaning_PM_StandardMonitor : NvM_Administration | P-Port Prototype of NvM_Administration for NVRAM Block Rte_NvmBlock_DPFAshCleaning_PM_StandardMonitor
      PAdmin_Rte_NvmBlock_DPFElectrodeCleaning_PM_StandardMonitor: provided-interface=NvM_Administration  # PPort_Rte_NvmBlock_DPFElectrodeCleaning_PM_StandardMonitor : NvM_Administration | P-Port Prototype of NvM_Administration for NVRAM Block Rte_NvmBlock_DPFElectrodeCleaning_PM_StandardMonitor
      PAdmin_Rte_NvmBlock_DPFFuelNozzleCleaning_PM_StandardMonitor: provided-interface=NvM_Administration  # PPort_Rte_NvmBlock_DPFFuelNozzleCleaning_PM_StandardMonitor : NvM_Administration | P-Port Prototype of NvM_Administration for NVRAM Block Rte_NvmBlock_DPFFuelNozzleCleaning_PM_StandardMonitor
      PAdmin_Rte_NvmBlock_EmissionTurboInjectionService_PM_StandardMonitor: provided-interface=NvM_Administration  # PPort_Rte_NvmBlock_EmissionTurboInjectionService_PM_StandardMonitor : NvM_Administration | P-Port Prototype of NvM_Administration for NVRAM Block Rte_NvmBlock_EmissionTurboInjectionService_PM_StandardMonitor
      PAdmin_Rte_NvmBlock_EngineBelt_PM_StandardMonitor: provided-interface=NvM_Administration  # PPort_Rte_NvmBlock_EngineBelt_PM_StandardMonitor : NvM_Administration | P-Port Prototype of NvM_Administration for NVRAM Block Rte_NvmBlock_EngineBelt_PM_StandardMonitor
      PAdmin_Rte_NvmBlock_FanClutchChange_PM_StandardMonitor: provided-interface=NvM_Administration  # PPort_Rte_NvmBlock_FanClutchChange_PM_StandardMonitor : NvM_Administration | P-Port Prototype of NvM_Administration for NVRAM Block Rte_NvmBlock_FanClutchChange_PM_StandardMonitor
      PAdmin_Rte_NvmBlock_FuelFilterChange_PM_StandardMonitor: provided-interface=NvM_Administration  # PPort_Rte_NvmBlock_FuelFilterChange_PM_StandardMonitor : NvM_Administration | P-Port Prototype of NvM_Administration for NVRAM Block Rte_NvmBlock_FuelFilterChange_PM_StandardMonitor
      PAdmin_Rte_NvmBlock_LW_PM_LastPadChange: provided-interface=NvM_Administration  # PPort_Rte_NvmBlock_LW_PM_LastPadChange : NvM_Administration | P-Port Prototype of NvM_Administration for NVRAM Block Rte_NvmBlock_LW_PM_LastPadChange
      PAdmin_Rte_NvmBlock_LW_PM_LiningWearMonitor: provided-interface=NvM_Administration  # PPort_Rte_NvmBlock_LW_PM_LiningWearMonitor : NvM_Administration | P-Port Prototype of NvM_Administration for NVRAM Block Rte_NvmBlock_LW_PM_LiningWearMonitor
      PAdmin_Rte_NvmBlock_OD_PM_OilDegradationPredictiveMonitor: provided-interface=NvM_Administration  # PPort_Rte_NvmBlock_OD_PM_OilDegradationPredictiveMonitor : NvM_Administration | P-Port Prototype of NvM_Administration for NVRAM Block Rte_NvmBlock_OD_PM_OilDegradationPredictiveMonitor
      PAdmin_Rte_NvmBlock_OD_PM_OilDegradationStandardMonitor: provided-interface=NvM_Administration  # PPort_Rte_NvmBlock_OD_PM_OilDegradationStandardMonitor : NvM_Administration | P-Port Prototype of NvM_Administration for NVRAM Block Rte_NvmBlock_OD_PM_OilDegradationStandardMonitor
      PAdmin_Rte_NvmBlock_OilFilterChange_PM_StandardMonitor: provided-interface=NvM_Administration  # PPort_Rte_NvmBlock_OilFilterChange_PM_StandardMonitor : NvM_Administration | P-Port Prototype of NvM_Administration for NVRAM Block Rte_NvmBlock_OilFilterChange_PM_StandardMonitor
      PAdmin_Rte_NvmBlock_PowerSteeringService_PM_StandardMonitor: provided-interface=NvM_Administration  # PPort_Rte_NvmBlock_PowerSteeringService_PM_StandardMonitor : NvM_Administration | P-Port Prototype of NvM_Administration for NVRAM Block Rte_NvmBlock_PowerSteeringService_PM_StandardMonitor
      PAdmin_Rte_NvmBlock_StarterBrush_PM_StandardMonitor: provided-interface=NvM_Administration  # PPort_Rte_NvmBlock_StarterBrush_PM_StandardMonitor : NvM_Administration | P-Port Prototype of NvM_Administration for NVRAM Block Rte_NvmBlock_StarterBrush_PM_StandardMonitor
      PAdmin_Rte_NvmBlock_TG_PM_TachographPredictiveMonitor: provided-interface=NvM_Administration  # PPort_Rte_NvmBlock_TG_PM_TachographPredictiveMonitor : NvM_Administration | P-Port Prototype of NvM_Administration for NVRAM Block Rte_NvmBlock_TG_PM_TachographPredictiveMonitor
      PAdmin_Rte_NvmBlock_TG_PM_TachographStandardMonitor: provided-interface=NvM_Administration  # PPort_Rte_NvmBlock_TG_PM_TachographStandardMonitor : NvM_Administration | P-Port Prototype of NvM_Administration for NVRAM Block Rte_NvmBlock_TG_PM_TachographStandardMonitor
      PAdmin_Rte_NvmBlock_TechnicalControlInspection_PM_StandardMonitor: provided-interface=NvM_Administration  # PPort_Rte_NvmBlock_TechnicalControlInspection_PM_StandardMonitor : NvM_Administration | P-Port Prototype of NvM_Administration for NVRAM Block Rte_NvmBlock_TechnicalControlInspection_PM_StandardMonitor
      PAdmin_Rte_NvmBlock_TransmissionOil_PM_StandardMonitor: provided-interface=NvM_Administration  # PPort_Rte_NvmBlock_TransmissionOil_PM_StandardMonitor : NvM_Administration | P-Port Prototype of NvM_Administration for NVRAM Block Rte_NvmBlock_TransmissionOil_PM_StandardMonitor
      PAdmin_Rte_NvmBlock_ValveLashUnitInjector_PM_StandardMonitor: provided-interface=NvM_Administration  # PPort_Rte_NvmBlock_ValveLashUnitInjector_PM_StandardMonitor : NvM_Administration | P-Port Prototype of NvM_Administration for NVRAM Block Rte_NvmBlock_ValveLashUnitInjector_PM_StandardMonitor
      PAdmin_Rte_NvmBlock_HLC_LCP_StatusMemorization: provided-interface=NvM_Administration  # PPort_Rte_NvmBlock_HLC_LCP_StatusMemorization : NvM_Administration | P-Port Prototype of NvM_Administration for NVRAM Block Rte_NvmBlock_HLC_LCP_StatusMemorization
      PAdmin_NV_EcocruiseDataGeneralData_P1GCO: provided-interface=NvM_Administration  # PPort_NV_EcocruiseDataGeneralData_P1GCO : NvM_Administration | P-Port Prototype of NvM_Administration for NVRAM Block NV_EcocruiseDataGeneralData_P1GCO
      PAdmin_NV_EcocruiseinFuelEcoActive_P1GCP: provided-interface=NvM_Administration  # PPort_NV_EcocruiseinFuelEcoActive_P1GCP : NvM_Administration | P-Port Prototype of NvM_Administration for NVRAM Block NV_EcocruiseinFuelEcoActive_P1GCP
      PAdmin_NV_EcocruiseDataPossibleBadDriverBehaviour_P1GCQ: provided-interface=NvM_Administration  # PPort_NV_EcocruiseDataPossibleBadDriverBehaviour_P1GCQ : NvM_Administration | P-Port Prototype of NvM_Administration for NVRAM Block NV_EcocruiseDataPossibleBadDriverBehaviour_P1GCQ
      PAdmin_Rte_NvmBlock_SCL_ESCLCabAndChassisAssembled: provided-interface=NvM_Administration  # PPort_Rte_NvmBlock_SCL_ESCLCabAndChassisAssembled : NvM_Administration | P-Port Prototype of NvM_Administration for NVRAM Block Rte_NvmBlock_SCL_ESCLCabAndChassisAssembled
      PAdmin_Rte_NvmBlock_DAL_prevBlackOutandConvoyMode_rqst: provided-interface=NvM_Administration  # PPort_Rte_NvmBlock_DAL_prevBlackOutandConvoyMode_rqst : NvM_Administration | P-Port Prototype of NvM_Administration for NVRAM Block Rte_NvmBlock_DAL_prevBlackOutandConvoyMode_rqst
      PAdmin_NV_LaneKeepingDriverBehaviour_P1HB2: provided-interface=NvM_Administration  # PPort_NV_LaneKeepingDriverBehaviour_P1HB2 : NvM_Administration | P-Port Prototype of NvM_Administration for NVRAM Block NV_LaneKeepingDriverBehaviour_P1HB2
      PAdmin_NV_BrakingWithBigDecelerationCounter_P1HB3: provided-interface=NvM_Administration  # PPort_NV_BrakingWithBigDecelerationCounter_P1HB3 : NvM_Administration | P-Port Prototype of NvM_Administration for NVRAM Block NV_BrakingWithBigDecelerationCounter_P1HB3
      PAdmin_NV_VehicleOverspeedLegalAndCustomer_P1HB5: provided-interface=NvM_Administration  # PPort_NV_VehicleOverspeedLegalAndCustomer_P1HB5 : NvM_Administration | P-Port Prototype of NvM_Administration for NVRAM Block NV_VehicleOverspeedLegalAndCustomer_P1HB5
      PAdmin_NV_OBDMalfunctionInformationAlert_P1G7P: provided-interface=NvM_Administration  # PPort_NV_OBDMalfunctionInformationAlert_P1G7P : NvM_Administration | P-Port Prototype of NvM_Administration for NVRAM Block NV_OBDMalfunctionInformationAlert_P1G7P
      PAdmin_NV_OBDFailureAlert_P1G7Q: provided-interface=NvM_Administration  # PPort_NV_OBDFailureAlert_P1G7Q : NvM_Administration | P-Port Prototype of NvM_Administration for NVRAM Block NV_OBDFailureAlert_P1G7Q
      PAdmin_NV_EngineOilPressureAlert_P1G7R: provided-interface=NvM_Administration  # PPort_NV_EngineOilPressureAlert_P1G7R : NvM_Administration | P-Port Prototype of NvM_Administration for NVRAM Block NV_EngineOilPressureAlert_P1G7R
      PAdmin_NV_EngineOilPressureStopAlert_P1G7S: provided-interface=NvM_Administration  # PPort_NV_EngineOilPressureStopAlert_P1G7S : NvM_Administration | P-Port Prototype of NvM_Administration for NVRAM Block NV_EngineOilPressureStopAlert_P1G7S
      PAdmin_NV_EngineDerating_P1HBN: provided-interface=NvM_Administration  # PPort_NV_EngineDerating_P1HBN : NvM_Administration | P-Port Prototype of NvM_Administration for NVRAM Block NV_EngineDerating_P1HBN
      PAdmin_NV_EngineOverspeedEOL_P1HBP: provided-interface=NvM_Administration  # PPort_NV_EngineOverspeedEOL_P1HBP : NvM_Administration | P-Port Prototype of NvM_Administration for NVRAM Block NV_EngineOverspeedEOL_P1HBP
      PAdmin_NV_EngineLowIdleSpeed_P1HBQ: provided-interface=NvM_Administration  # PPort_NV_EngineLowIdleSpeed_P1HBQ : NvM_Administration | P-Port Prototype of NvM_Administration for NVRAM Block NV_EngineLowIdleSpeed_P1HBQ
      PAdmin_NV_EngineOverspeedWithEngineBrake_P1HBR: provided-interface=NvM_Administration  # PPort_NV_EngineOverspeedWithEngineBrake_P1HBR : NvM_Administration | P-Port Prototype of NvM_Administration for NVRAM Block NV_EngineOverspeedWithEngineBrake_P1HBR
      PAdmin_NV_EngineOverspeedWhateverEngineBrakeStatus_P1HBT: provided-interface=NvM_Administration  # PPort_NV_EngineOverspeedWhateverEngineBrakeStatus_P1HBT : NvM_Administration | P-Port Prototype of NvM_Administration for NVRAM Block NV_EngineOverspeedWhateverEngineBrakeStatus_P1HBT
      PAdmin_NV_EngineOverspeedCustomer_P1HBU: provided-interface=NvM_Administration  # PPort_NV_EngineOverspeedCustomer_P1HBU : NvM_Administration | P-Port Prototype of NvM_Administration for NVRAM Block NV_EngineOverspeedCustomer_P1HBU
      PAdmin_NV_TotalVehicleWeightLoggingParameters_P1G7O: provided-interface=NvM_Administration  # PPort_NV_TotalVehicleWeightLoggingParameters_P1G7O : NvM_Administration | P-Port Prototype of NvM_Administration for NVRAM Block NV_TotalVehicleWeightLoggingParameters_P1G7O
      PAdmin_NV_InGreenArea_P1HBV: provided-interface=NvM_Administration  # PPort_NV_InGreenArea_P1HBV : NvM_Administration | P-Port Prototype of NvM_Administration for NVRAM Block NV_InGreenArea_P1HBV
      PAdmin_NV_OutOfGreenArea_P1HBW: provided-interface=NvM_Administration  # PPort_NV_OutOfGreenArea_P1HBW : NvM_Administration | P-Port Prototype of NvM_Administration for NVRAM Block NV_OutOfGreenArea_P1HBW
      PAdmin_NV_AdblueConsumption_P1HBY: provided-interface=NvM_Administration  # PPort_NV_AdblueConsumption_P1HBY : NvM_Administration | P-Port Prototype of NvM_Administration for NVRAM Block NV_AdblueConsumption_P1HBY
      PAdmin_NV_AdblueLowLevelTank_P1HBZ: provided-interface=NvM_Administration  # PPort_NV_AdblueLowLevelTank_P1HBZ : NvM_Administration | P-Port Prototype of NvM_Administration for NVRAM Block NV_AdblueLowLevelTank_P1HBZ
      PAdmin_NV_AdblueHighTemperature_P1HB0: provided-interface=NvM_Administration  # PPort_NV_AdblueHighTemperature_P1HB0 : NvM_Administration | P-Port Prototype of NvM_Administration for NVRAM Block NV_AdblueHighTemperature_P1HB0
      PAdmin_NV_AdblueLowTemperature_P1HB1: provided-interface=NvM_Administration  # PPort_NV_AdblueLowTemperature_P1HB1 : NvM_Administration | P-Port Prototype of NvM_Administration for NVRAM Block NV_AdblueLowTemperature_P1HB1
      PAdmin_NV_EngineCoolantTemperatureAndLevelEventLogs_P1HBO: provided-interface=NvM_Administration  # PPort_NV_EngineCoolantTemperatureAndLevelEventLogs_P1HBO : NvM_Administration | P-Port Prototype of NvM_Administration for NVRAM Block NV_EngineCoolantTemperatureAndLevelEventLogs_P1HBO
      PAdmin_NV_PTOUseLoggingData_P1G7N: provided-interface=NvM_Administration  # PPort_NV_PTOUseLoggingData_P1G7N : NvM_Administration | P-Port Prototype of NvM_Administration for NVRAM Block NV_PTOUseLoggingData_P1G7N
      PAdmin_NV_NoDriverCardInTheTachograph_P1G7J: provided-interface=NvM_Administration  # PPort_NV_NoDriverCardInTheTachograph_P1G7J : NvM_Administration | P-Port Prototype of NvM_Administration for NVRAM Block NV_NoDriverCardInTheTachograph_P1G7J
      PAdmin_NV_SeatBeltDriverUsage_P1G7M: provided-interface=NvM_Administration  # PPort_NV_SeatBeltDriverUsage_P1G7M : NvM_Administration | P-Port Prototype of NvM_Administration for NVRAM Block NV_SeatBeltDriverUsage_P1G7M
      PAdmin_NV_BatteryData_P1HB6: provided-interface=NvM_Administration  # PPort_NV_BatteryData_P1HB6 : NvM_Administration | P-Port Prototype of NvM_Administration for NVRAM Block NV_BatteryData_P1HB6
      PAdmin_NV_BatteryData3_P1HB8: provided-interface=NvM_Administration  # PPort_NV_BatteryData3_P1HB8 : NvM_Administration | P-Port Prototype of NvM_Administration for NVRAM Block NV_BatteryData3_P1HB8
      PAdmin_NV_CruiseControlWithRetarder_P1HCA: provided-interface=NvM_Administration  # PPort_NV_CruiseControlWithRetarder_P1HCA : NvM_Administration | P-Port Prototype of NvM_Administration for NVRAM Block NV_CruiseControlWithRetarder_P1HCA
      PAdmin_NV_CruiseControlOverspeedInDownhill_P1HCB: provided-interface=NvM_Administration  # PPort_NV_CruiseControlOverspeedInDownhill_P1HCB : NvM_Administration | P-Port Prototype of NvM_Administration for NVRAM Block NV_CruiseControlOverspeedInDownhill_P1HCB
      PAdmin_NV_CruiseControlOverEngineLoad_P1HCC: provided-interface=NvM_Administration  # PPort_NV_CruiseControlOverEngineLoad_P1HCC : NvM_Administration | P-Port Prototype of NvM_Administration for NVRAM Block NV_CruiseControlOverEngineLoad_P1HCC
      PAdmin_NV_CruiseControlHistogram_P1HCD: provided-interface=NvM_Administration  # PPort_NV_CruiseControlHistogram_P1HCD : NvM_Administration | P-Port Prototype of NvM_Administration for NVRAM Block NV_CruiseControlHistogram_P1HCD
      PAdmin_NV_CruiseControlGeneralData_P1HCE: provided-interface=NvM_Administration  # PPort_NV_CruiseControlGeneralData_P1HCE : NvM_Administration | P-Port Prototype of NvM_Administration for NVRAM Block NV_CruiseControlGeneralData_P1HCE
      PAdmin_NV_ASRData_P1HDZ: provided-interface=NvM_Administration  # PPort_NV_ASRData_P1HDZ : NvM_Administration | P-Port Prototype of NvM_Administration for NVRAM Block NV_ASRData_P1HDZ
      PAdmin_NV_BrakingAndRetarderData_P1HD4: provided-interface=NvM_Administration  # PPort_NV_BrakingAndRetarderData_P1HD4 : NvM_Administration | P-Port Prototype of NvM_Administration for NVRAM Block NV_BrakingAndRetarderData_P1HD4
      PAdmin_NV_EngineOverload_P1HD5: provided-interface=NvM_Administration  # PPort_NV_EngineOverload_P1HD5 : NvM_Administration | P-Port Prototype of NvM_Administration for NVRAM Block NV_EngineOverload_P1HD5
      PAdmin_NV_RobotizedGearbox_P1HD6: provided-interface=NvM_Administration  # PPort_NV_RobotizedGearbox_P1HD6 : NvM_Administration | P-Port Prototype of NvM_Administration for NVRAM Block NV_RobotizedGearbox_P1HD6
      PAdmin_NV_Coasting_P1HD7: provided-interface=NvM_Administration  # PPort_NV_Coasting_P1HD7 : NvM_Administration | P-Port Prototype of NvM_Administration for NVRAM Block NV_Coasting_P1HD7
      PAdmin_NV_EngineFuelHistograms_P1HD8: provided-interface=NvM_Administration  # PPort_NV_EngineFuelHistograms_P1HD8 : NvM_Administration | P-Port Prototype of NvM_Administration for NVRAM Block NV_EngineFuelHistograms_P1HD8
      PAdmin_NV_EngineFuelConsumptionGeneralData_P1HD9: provided-interface=NvM_Administration  # PPort_NV_EngineFuelConsumptionGeneralData_P1HD9 : NvM_Administration | P-Port Prototype of NvM_Administration for NVRAM Block NV_EngineFuelConsumptionGeneralData_P1HD9
      PAdmin_NV_EngineRetarderCounters_P1HEA: provided-interface=NvM_Administration  # PPort_NV_EngineRetarderCounters_P1HEA : NvM_Administration | P-Port Prototype of NvM_Administration for NVRAM Block NV_EngineRetarderCounters_P1HEA
      PAdmin_NV_EngineRetarderHistograms_P1HEB: provided-interface=NvM_Administration  # PPort_NV_EngineRetarderHistograms_P1HEB : NvM_Administration | P-Port Prototype of NvM_Administration for NVRAM Block NV_EngineRetarderHistograms_P1HEB
      PAdmin_NV_VehicleOverspeed_P1HEC: provided-interface=NvM_Administration  # PPort_NV_VehicleOverspeed_P1HEC : NvM_Administration | P-Port Prototype of NvM_Administration for NVRAM Block NV_VehicleOverspeed_P1HEC
      PAdmin_NV_EngineTimeHistograms_P1HFG: provided-interface=NvM_Administration  # PPort_NV_EngineTimeHistograms_P1HFG : NvM_Administration | P-Port Prototype of NvM_Administration for NVRAM Block NV_EngineTimeHistograms_P1HFG
      PAdmin_NV_LiftAxlesUse_P1HFK: provided-interface=NvM_Administration  # PPort_NV_LiftAxlesUse_P1HFK : NvM_Administration | P-Port Prototype of NvM_Administration for NVRAM Block NV_LiftAxlesUse_P1HFK
      PAdmin_NV_AirConditioning_P1HGT: provided-interface=NvM_Administration  # PPort_NV_AirConditioning_P1HGT : NvM_Administration | P-Port Prototype of NvM_Administration for NVRAM Block NV_AirConditioning_P1HGT
      PAdmin_NV_DrivelineRetarderLoggingData_P1HGU: provided-interface=NvM_Administration  # PPort_NV_DrivelineRetarderLoggingData_P1HGU : NvM_Administration | P-Port Prototype of NvM_Administration for NVRAM Block NV_DrivelineRetarderLoggingData_P1HGU
      PAdmin_NV_TractorTrailerBrakingHarmonization_P1HGV: provided-interface=NvM_Administration  # PPort_NV_TractorTrailerBrakingHarmonization_P1HGV : NvM_Administration | P-Port Prototype of NvM_Administration for NVRAM Block NV_TractorTrailerBrakingHarmonization_P1HGV
      PAdmin_NV_AirCompressor_P1HGW: provided-interface=NvM_Administration  # PPort_NV_AirCompressor_P1HGW : NvM_Administration | P-Port Prototype of NvM_Administration for NVRAM Block NV_AirCompressor_P1HGW
      PAdmin_NV_EngineStartInBackupMode_P1HGX: provided-interface=NvM_Administration  # PPort_NV_EngineStartInBackupMode_P1HGX : NvM_Administration | P-Port Prototype of NvM_Administration for NVRAM Block NV_EngineStartInBackupMode_P1HGX
      PAdmin_NV_DrivingMonitoringSystem_P1HGY: provided-interface=NvM_Administration  # PPort_NV_DrivingMonitoringSystem_P1HGY : NvM_Administration | P-Port Prototype of NvM_Administration for NVRAM Block NV_DrivingMonitoringSystem_P1HGY
      PAdmin_NV_VehicleModesData_P1HGZ: provided-interface=NvM_Administration  # PPort_NV_VehicleModesData_P1HGZ : NvM_Administration | P-Port Prototype of NvM_Administration for NVRAM Block NV_VehicleModesData_P1HGZ
      PAdmin_NV_IgnitionLogging_P1HG0: provided-interface=NvM_Administration  # PPort_NV_IgnitionLogging_P1HG0 : NvM_Administration | P-Port Prototype of NvM_Administration for NVRAM Block NV_IgnitionLogging_P1HG0
      PAdmin_NV_FifthWheel_P1HG2: provided-interface=NvM_Administration  # PPort_NV_FifthWheel_P1HG2 : NvM_Administration | P-Port Prototype of NvM_Administration for NVRAM Block NV_FifthWheel_P1HG2
      PAdmin_NV_EngineTrueIdleSpeed_P1HG4: provided-interface=NvM_Administration  # PPort_NV_EngineTrueIdleSpeed_P1HG4 : NvM_Administration | P-Port Prototype of NvM_Administration for NVRAM Block NV_EngineTrueIdleSpeed_P1HG4
      PAdmin_NV_ABSData_P1HG8: provided-interface=NvM_Administration  # PPort_NV_ABSData_P1HG8 : NvM_Administration | P-Port Prototype of NvM_Administration for NVRAM Block NV_ABSData_P1HG8
      PAdmin_NV_VehicleMotion_P1HG6: provided-interface=NvM_Administration  # PPort_NV_VehicleMotion_P1HG6 : NvM_Administration | P-Port Prototype of NvM_Administration for NVRAM Block NV_VehicleMotion_P1HG6
      PAdmin_NV_ParkBrakeData_P1HG7: provided-interface=NvM_Administration  # PPort_NV_ParkBrakeData_P1HG7 : NvM_Administration | P-Port Prototype of NvM_Administration for NVRAM Block NV_ParkBrakeData_P1HG7
      PAdmin_NV_LinearClutchPedalSensorEndPos_P1HIR: provided-interface=NvM_Administration  # PPort_NV_LinearClutchPedalSensorEndPos_P1HIR : NvM_Administration | P-Port Prototype of NvM_Administration for NVRAM Block NV_LinearClutchPedalSensorEndPos_P1HIR
      PAdmin_Rte_NvmBlock_OBL_Admin: provided-interface=NvM_Administration  # PPort_Rte_NvmBlock_OBL_Admin : NvM_Administration | P-Port Prototype of NvM_Administration for NVRAM Block Rte_NvmBlock_OBL_Admin
      PAdmin_Rte_NvmBlock_OPL_Admin: provided-interface=NvM_Administration  # PPort_Rte_NvmBlock_OPL_Admin : NvM_Administration | P-Port Prototype of NvM_Administration for NVRAM Block Rte_NvmBlock_OPL_Admin
      PAdmin_NV_BrakeAssistData_P1HOE: provided-interface=NvM_Administration  # PPort_NV_BrakeAssistData_P1HOE : NvM_Administration | P-Port Prototype of NvM_Administration for NVRAM Block NV_BrakeAssistData_P1HOE
      PAdmin_NV_LaneKeepingDriverImpairment_P1HOF: provided-interface=NvM_Administration  # PPort_NV_LaneKeepingDriverImpairment_P1HOF : NvM_Administration | P-Port Prototype of NvM_Administration for NVRAM Block NV_LaneKeepingDriverImpairment_P1HOF
      PAdmin_NV_ESPData_P1HOG: provided-interface=NvM_Administration  # PPort_NV_ESPData_P1HOG : NvM_Administration | P-Port Prototype of NvM_Administration for NVRAM Block NV_ESPData_P1HOG
      PAdmin_NV_BatteryData2_P1HOH: provided-interface=NvM_Administration  # PPort_NV_BatteryData2_P1HOH : NvM_Administration | P-Port Prototype of NvM_Administration for NVRAM Block NV_BatteryData2_P1HOH
      PAdmin_NV_VehicleTechnicalStatusIgnoredByDriver_P1HOI: provided-interface=NvM_Administration  # PPort_NV_VehicleTechnicalStatusIgnoredByDriver_P1HOI : NvM_Administration | P-Port Prototype of NvM_Administration for NVRAM Block NV_VehicleTechnicalStatusIgnoredByDriver_P1HOI
      PAdmin_NV_NotEngagedParkBrakeWhenDriverOutsideTheVehicle_P1HOJ: provided-interface=NvM_Administration  # PPort_NV_NotEngagedParkBrakeWhenDriverOutsideTheVehicle_P1HOJ : NvM_Administration | P-Port Prototype of NvM_Administration for NVRAM Block NV_NotEngagedParkBrakeWhenDriverOutsideTheVehicle_P1HOJ
      PAdmin_NV_LoadIndication_P1HOK: provided-interface=NvM_Administration  # PPort_NV_LoadIndication_P1HOK : NvM_Administration | P-Port Prototype of NvM_Administration for NVRAM Block NV_LoadIndication_P1HOK
      PAdmin_NV_IntakeAirOverheatAlertEvent_P1HOL: provided-interface=NvM_Administration  # PPort_NV_IntakeAirOverheatAlertEvent_P1HOL : NvM_Administration | P-Port Prototype of NvM_Administration for NVRAM Block NV_IntakeAirOverheatAlertEvent_P1HOL
      PAdmin_NV_EngineOverspeedWithoutEngineBrake_P1HOM: provided-interface=NvM_Administration  # PPort_NV_EngineOverspeedWithoutEngineBrake_P1HOM : NvM_Administration | P-Port Prototype of NvM_Administration for NVRAM Block NV_EngineOverspeedWithoutEngineBrake_P1HOM
      PAdmin_Rte_NvmBlock_OBDDP_DrivingCycleActive: provided-interface=NvM_Administration  # PPort_Rte_NvmBlock_OBDDP_DrivingCycleActive : NvM_Administration | P-Port Prototype of NvM_Administration for NVRAM Block Rte_NvmBlock_OBDDP_DrivingCycleActive
      PAdmin_NV_CollisionMitigationData_P1HTK: provided-interface=NvM_Administration  # PPort_NV_CollisionMitigationData_P1HTK : NvM_Administration | P-Port Prototype of NvM_Administration for NVRAM Block NV_CollisionMitigationData_P1HTK
      PAdmin_NV_DiagnosticData_P1H52: provided-interface=NvM_Administration  # PPort_NV_DiagnosticData_P1H52 : NvM_Administration | P-Port Prototype of NvM_Administration for NVRAM Block NV_DiagnosticData_P1H52
      PAdmin_NV_AirIntake_P1H98: provided-interface=NvM_Administration  # PPort_NV_AirIntake_P1H98 : NvM_Administration | P-Port Prototype of NvM_Administration for NVRAM Block NV_AirIntake_P1H98
      PAdmin_NV_EngineCoolantTemperatureAndLevelServiceAlert_P1H99: provided-interface=NvM_Administration  # PPort_NV_EngineCoolantTemperatureAndLevelServiceAlert_P1H99 : NvM_Administration | P-Port Prototype of NvM_Administration for NVRAM Block NV_EngineCoolantTemperatureAndLevelServiceAlert_P1H99
      PAdmin_NV_EngineCoolantTemperatureAndLevelStopAlert_P1IAA: provided-interface=NvM_Administration  # PPort_NV_EngineCoolantTemperatureAndLevelStopAlert_P1IAA : NvM_Administration | P-Port Prototype of NvM_Administration for NVRAM Block NV_EngineCoolantTemperatureAndLevelStopAlert_P1IAA
      PAdmin_Rte_NvmBlock_AD_ACDData: provided-interface=NvM_Administration  # PPort_Rte_NvmBlock_AD_ACDData : NvM_Administration | P-Port Prototype of NvM_Administration for NVRAM Block Rte_NvmBlock_AD_ACDData
      PAdmin_Rte_NvmBlock_IKeyMapper_IgnitionKeyPosition: provided-interface=NvM_Administration  # PPort_Rte_NvmBlock_IKeyMapper_IgnitionKeyPosition : NvM_Administration | P-Port Prototype of NvM_Administration for NVRAM Block Rte_NvmBlock_IKeyMapper_IgnitionKeyPosition
      PAdmin_Rte_NvmBlock_SCL_ESCLData: provided-interface=NvM_Administration  # PPort_Rte_NvmBlock_SCL_ESCLData : NvM_Administration | P-Port Prototype of NvM_Administration for NVRAM Block Rte_NvmBlock_SCL_ESCLData
      PAdmin_Rte_NvmBlock_OBL_OBDContinuousMIAlert_P1ITL: provided-interface=NvM_Administration  # PPort_Rte_NvmBlock_OBL_OBDContinuousMIAlert_P1ITL : NvM_Administration | P-Port Prototype of NvM_Administration for NVRAM Block Rte_NvmBlock_OBL_OBDContinuousMIAlert_P1ITL
      PAdmin_Rte_NvmBlock_OBL_OBDOnDemandMIAlert_P1ITJ: provided-interface=NvM_Administration  # PPort_Rte_NvmBlock_OBL_OBDOnDemandMIAlert_P1ITJ : NvM_Administration | P-Port Prototype of NvM_Administration for NVRAM Block Rte_NvmBlock_OBL_OBDOnDemandMIAlert_P1ITJ
      PAdmin_Rte_NvmBlock_OBL_OBDShortMIAlert_P1ITK: provided-interface=NvM_Administration  # PPort_Rte_NvmBlock_OBL_OBDShortMIAlert_P1ITK : NvM_Administration | P-Port Prototype of NvM_Administration for NVRAM Block Rte_NvmBlock_OBL_OBDShortMIAlert_P1ITK
      PAdmin_Rte_NvmBlock_OBDDP_ESCAN00058605: provided-interface=NvM_Administration  # PPort_Rte_NvmBlock_OBDDP_ESCAN00058605 : NvM_Administration | P-Port Prototype of NvM_Administration for NVRAM Block Rte_NvmBlock_OBDDP_ESCAN00058605
      PAdmin_Rte_NvmBlock_VM_VM_VehicleMode_Pim: provided-interface=NvM_Administration  # PPort_Rte_NvmBlock_VM_VM_VehicleMode_Pim : NvM_Administration | P-Port Prototype of NvM_Administration for NVRAM Block Rte_NvmBlock_VM_VM_VehicleMode_Pim
    require port NvM_RpNotifyJobEnd_Rte_NvmBlock_VM_VM_VehicleMode_Pim: required-interface=NvM_NotifyJobFinished  # RPort_Rte_NvmBlock_VM_VM_VehicleMode_Pim : NvM_NotifyJobFinished | R-Port Prototype of NvM_NotifyJobFinished for NVRAM Block Rte_NvmBlock_VM_VM_VehicleMode_Pim
  swc implementation NvM_Impl: behavior=NvM_Behavior
